## components/buses/Kconfig
```kconfig
menu "Buses"
    config BUS_SPI2_ENABLE
        bool "Enable the SPI2 bus"
        default n

    config PIN_NUM_SPI2_CLK
        depends on BUS_SPI2_ENABLE
        int "GPIO pin used for SPI2 CLK"

    config PIN_NUM_SPI2_MOSI
        depends on BUS_SPI2_ENABLE
        int "GPIO pin used for SPI2 MOSI"

    config PIN_NUM_SPI2_MISO
        depends on BUS_SPI2_ENABLE
        int "GPIO pin used for SPI2 MISO"

    config BUS_SPI2_MAX_TRANSFERSIZE
        depends on BUS_SPI2_ENABLE
        int "SPI2 Maximum transfer size (in bytes)"
        default 4094

    config BUS_SPI3_ENABLE
        bool "Enable the SPI3 bus"
        default n

    config PIN_NUM_SPI3_CLK
        depends on BUS_SPI3_ENABLE
        int "GPIO pin used for SPI3 CLK"

    config PIN_NUM_SPI3_MOSI
        depends on BUS_SPI3_ENABLE
        int "GPIO pin used for SPI3 MOSI"

    config PIN_NUM_SPI3_MISO
        depends on BUS_SPI3_ENABLE
        int "GPIO pin used for SPI3 MISO"
        
    config BUS_SPI3_MAX_TRANSFERSIZE
        depends on BUS_SPI3_ENABLE
        int "SPI3 Maximum transfer size (in bytes)"
        default 4094
        
    config BUS_I2C0_ENABLE
        bool "Enable I2C controller 0"
        default n
    
    config PIN_NUM_I2C0_DATA
        depends on BUS_I2C0_ENABLE
        int "GPIO pin used for I2C0 data"
    
    config PIN_NUM_I2C0_CLK
        depends on BUS_I2C0_ENABLE
        int "GPIO pin used for I2C0 clock"
    
    config PIN_PULL_I2C0_DATA
        depends on BUS_I2C0_ENABLE
        bool "Enable the built-in pull-up for the I2C0 data pin"
        default n
    
    config PIN_PULL_I2C0_CLK
        depends on BUS_I2C0_ENABLE
        bool "Enable the built-in pull-up for the I2C0 clock pin"
        default n
    
    config I2C0_MASTER_FREQ_HZ
        depends on BUS_I2C0_ENABLE
        int "I2C0 speed in Hz"
        default 100000

    config BUS_I2C1_ENABLE
        bool "Enable I2C controller 1"
        default n
    
    config PIN_NUM_I2C1_DATA
        depends on BUS_I2C1_ENABLE
        int "GPIO pin used for I2C1 data"
    
    config PIN_NUM_I2C1_CLK
        depends on BUS_I2C1_ENABLE
        int "GPIO pin used for I2C1 clock"
    
    config PIN_PULL_I2C1_DATA
        depends on BUS_I2C1_ENABLE
        bool "Enable the built-in pull-up for the I2C1 data pin"
        default n
    
    config PIN_PULL_I2C1_CLK
        depends on BUS_I2C1_ENABLE
        bool "Enable the built-in pull-up for the I2C1 clock pin"
        default n
    
    config I2C1_MASTER_FREQ_HZ
        depends on BUS_I2C1_ENABLE
        int "I2C1 speed in Hz"
        default 100000
endmenu
```

## components/driver_display/Kconfig
```kconfig
menu "Driver: Generic display"
	config DISPLAY_ENABLE
		bool "Enable the display driver"
		default n
	
	config DISPLAY_TYPE
		depends on DRIVER_DISPLAY_ENABLE
		int
		default 0 if DISPLAY_SCREEN_CONTROLLER_SSD1306
		choice
			prompt "Set display type"
			default DISPLAY_SCREEN_CONTROLLER_SSD1306
			config DISPLAY_SCREEN_CONTROLLER_SSD1306
				bool "SSD1306"
			config DISPLAY_SCREEN_CONTROLLER_GC9A01
				bool "GC9A01"
		endchoice
	
	config DISPLAY_INTERFACE
		depends on DRIVER_DISPLAY_ENABLE
		int
		default 0 if DISPLAY_SPI
		default 1 if DISPLAU_I2C
		choice
			prompt "Set interface"
			default DISPLAY_SPI
			config DISPLAY_SPI
				bool "SPI"
			config DISPLAY_I2C
				bool "I2C"
		endchoice
	config DISPLAY_PIN_CS
		depends on DISPLAY_SPI
		int "Chip select pin"
		default -1
	config DISPLAY_PIN_DC
		depends on DISPLAY_SPI
		int "Data/command pin"
		default -1
	config DISPLAY_PIN_RST
		int "Reset pin"
		default -1
	config DISPLAY_I2C_ADDR
		depends on DISPLAY_I2C
		int "I2C Addres"
		default 0
	config DISPLAY_WIDTH
		depends on DRIVER_DISPLAY_ENABLE
		int "Width"
		default 128
	config DISPLAY_HEIGHT
		depends on DRIVER_DISPLAY_ENABLE
		int "Height"
		default 64
	config DISPLAY_HORIZONTAL_OFFSET
		depends on DRIVER_DISPLAY_ENABLE
		int "Offset horizontal"
		default 0
	config DISPLAY_VERTICAL_OFFSET
		depends on DRIVER_DISPLAY_ENABLE
		int "Offset vertical"
		default 0
endmenu
```

## components/pyota/Kconfig
```kconfig
menu "PYOTA"
    config PYOTA_ENABLE
        bool "Enable python based ota"
        default n
    config PYOTA_SKIP_VERSION_CHECK
        bool "Disable version check"
        default n
endmenu
```
